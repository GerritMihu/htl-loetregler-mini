#include "ssd1306.h"
#include <stdlib.h>

// 5x8 ASCII Font (Standard für OLED-Displays)
static const uint8_t font5x8[] = {
    0x00, 0x00, 0x00, 0x00, 0x00, // Space
    0x00, 0x00, 0x5F, 0x00, 0x00, // !
    0x00, 0x07, 0x00, 0x07, 0x00, // "
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    0x08, 0x1C, 0x2A, 0x08, 0x08  // <-
};

// Sende einen Befehl an den SSD1306 Controller
void ssd1306_command(ssd1306_t *display, uint8_t command) {
    uint8_t buf[2] = {0x00, command}; // 0x00 für Befehlsmodus
    i2c_write_blocking(display->i2c, display->address, buf, 2, false);
}

// Sende mehrere Befehle an den SSD1306 Controller
void ssd1306_commands(ssd1306_t *display, uint8_t *commands, uint8_t count) {
    uint8_t buf[count * 2];
    for (uint8_t i = 0; i < count; i++) {
        buf[i * 2] = 0x00;           // Befehlsmodus
        buf[i * 2 + 1] = commands[i]; // Befehl
    }
    i2c_write_blocking(display->i2c, display->address, buf, count * 2, false);
}

// Initialisiere den SSD1306 Display
void ssd1306_init(ssd1306_t *display, i2c_inst_t *i2c_instance, uint8_t address, uint8_t width, uint8_t height) {
    display->i2c = i2c_instance;
    display->address = address;
    display->width = width;
    display->height = height;
    display->pages = height / 8; // 8 Pixel pro Page (Vertical)

    // Speicher für den Framebuffer allozieren
    display->buffer = malloc(width * display->pages);
    if (display->buffer) {
        memset(display->buffer, 0, width * display->pages);
    }

    // Initialisierungssequenz
    uint8_t init_commands[] = {
        SSD1306_DISPLAYOFF,          // 0xAE
        SSD1306_SETDISPLAYCLOCKDIV,  // 0xD5
        0x80,                        // Empfohlener Wert
        SSD1306_SETMULTIPLEX,        // 0xA8
        height - 1,
        SSD1306_SETDISPLAYOFFSET,    // 0xD3
        0x00,                        // Kein Offset
        SSD1306_SETSTARTLINE | 0x00, // Startlinie = 0
        SSD1306_CHARGEPUMP,          // 0x8D
        0x14,                        // Vcc intern erzeugen
        SSD1306_MEMORYMODE,          // 0x20
        0x00,                        // Horizontale Adressierung
        SSD1306_SEGREMAP | 0x01,     // Spalte 127 mapped zu SEG0
        SSD1306_COMSCANDEC,          // 0xC8, scan von COM[N-1] bis COM0
        SSD1306_SETCOMPINS,          // 0xDA
        (height == 32) ? 0x02 : 0x12, // COM Pins für 32px oder 64px Display
        SSD1306_SETCONTRAST,         // 0x81
        0x8F,
        SSD1306_SETPRECHARGE,        // 0xD9
        0xF1,                        // Interne Vorladung
        SSD1306_SETVCOMDETECT,       // 0xDB
        0x40,                        // Default
        SSD1306_DISPLAYALLON_RESUME, // 0xA4
        SSD1306_NORMALDISPLAY,       // 0xA6
        SSD1306_DISPLAYON            // 0xAF
    };

    for (uint8_t i = 0; i < sizeof(init_commands); i++) {
        ssd1306_command(display, init_commands[i]);
    }
}

// Display löschen (Frame Buffer auf 0 setzen)
void ssd1306_clear(ssd1306_t *display) {
    if (display->buffer) {
        memset(display->buffer, 0, display->width * display->pages);
    }
}

// Frame Buffer auf das Display senden
void ssd1306_show(ssd1306_t *display) {
    if (!display->buffer) return;

    ssd1306_command(display, SSD1306_COLUMNADDR);
    ssd1306_command(display, 0);                   // Startkolumne
    ssd1306_command(display, display->width - 1);  // Endkolumne

    ssd1306_command(display, SSD1306_PAGEADDR);
    ssd1306_command(display, 0);                   // Startpage
    ssd1306_command(display, display->pages - 1);  // Endpage

    // Daten senden
    for (uint32_t i = 0; i < display->width * display->pages; i += 16) {
        uint8_t buffer[17]; // 16 Bytes Daten + 1 Byte Kontrollbyte
        buffer[0] = 0x40;   // Co = 0, D/C = 1 (Datenmodus)

        // Bestimme, wie viele Bytes noch zu senden sind
        uint32_t remaining = display->width * display->pages - i;
        uint32_t chunk_size = (remaining < 16) ? remaining : 16;

        // Kopiere die Daten in den Puffer
        memcpy(&buffer[1], &display->buffer[i], chunk_size);

        // Sende die Daten
        i2c_write_blocking(display->i2c, display->address, buffer, chunk_size + 1, false);
    }
}

// Setze ein Pixel im Frame Buffer
void ssd1306_set_pixel(ssd1306_t *display, uint8_t x, uint8_t y, bool on) {
    if (x >= display->width || y >= display->height || !display->buffer) return;

    uint8_t page = y / 8;
    uint8_t bit = y % 8;

    if (on) {
        display->buffer[x + page * display->width] |= (1 << bit);
    } else {
        display->buffer[x + page * display->width] &= ~(1 << bit);
    }
}

// Zeichne ein einzelnes Zeichen
void ssd1306_draw_char(ssd1306_t *display, uint8_t x, uint8_t y, uint8_t scale, char c) {
    if (c < 32 || c > 127) return;

    uint8_t char_idx = c - 32;

    for (uint8_t w = 0; w < 5; w++) {
        uint8_t line = font5x8[char_idx * 5 + w];

        for (uint8_t h = 0; h < 8; h++) {
            if (line & (1 << h)) {
                if (scale == 1) {
                    ssd1306_set_pixel(display, x + w, y + h, true);
                } else {
                    // Vergrößerte Darstellung
                    for (uint8_t sx = 0; sx < scale; sx++) {
                        for (uint8_t sy = 0; sy < scale; sy++) {
                            ssd1306_set_pixel(display, x + w * scale + sx, y + h * scale + sy, true);
                        }
                    }
                }
            }
        }
    }
}

// Zeichne einen Text-String
void ssd1306_draw_string(ssd1306_t *display, uint8_t x, uint8_t y, uint8_t scale, const char *s) {
    uint8_t curr_x = x;

    while (*s) {
        ssd1306_draw_char(display, curr_x, y, scale, *s);
        curr_x += 6 * scale; // 5 Pixel Breite + 1 Pixel Abstand
        s++;

        // Zeilenumbruch, wenn am rechten Rand
        if (curr_x > display->width - 6 * scale) {
            curr_x = 0;
            y += 8 * scale; // 8 Pixel Höhe

            // Ende, wenn unten angekommen
            if (y > display->height - 8 * scale) {
                break;
            }
        }
    }
}
