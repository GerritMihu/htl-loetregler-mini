#include "ssd1306_simple.h"

#include <string.h>

#define SSD1306_DISPLAYOFF 0xAE
#define SSD1306_DISPLAYON 0xAF
#define SSD1306_SETDISPLAYCLOCKDIV 0xD5
#define SSD1306_SETMULTIPLEX 0xA8
#define SSD1306_SETDISPLAYOFFSET 0xD3
#define SSD1306_SETSTARTLINE 0x40
#define SSD1306_CHARGEPUMP 0x8D
#define SSD1306_MEMORYMODE 0x20
#define SSD1306_SEGREMAP 0xA0
#define SSD1306_COMSCANDEC 0xC8
#define SSD1306_SETCOMPINS 0xDA
#define SSD1306_SETCONTRAST 0x81
#define SSD1306_SETPRECHARGE 0xD9
#define SSD1306_SETVCOMDETECT 0xDB
#define SSD1306_DISPLAYALLON_RESUME 0xA4
#define SSD1306_NORMALDISPLAY 0xA6
#define SSD1306_COLUMNADDR 0x21
#define SSD1306_PAGEADDR 0x22

static const uint8_t FONT_5X8[] = {
    0x00, 0x00, 0x00, 0x00, 0x00, 0x00, 0x00, 0x5F, 0x00, 0x00, 0x00, 0x07, 0x00, 0x07, 0x00,
    0x14, 0x7F, 0x14, 0x7F, 0x14, 0x24, 0x2A, 0x7F, 0x2A, 0x12, 0x23, 0x13, 0x08, 0x64, 0x62,
    0x36, 0x49, 0x55, 0x22, 0x50, 0x00, 0x05, 0x03, 0x00, 0x00, 0x00, 0x1C, 0x22, 0x41, 0x00,
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    0x00, 0x41, 0x36, 0x08, 0x00, 0x08, 0x08, 0x2A, 0x1C, 0x08, 0x08, 0x1C, 0x2A, 0x08, 0x08
};

static void ssd1306_command(ssd1306_t *display, uint8_t command) {
  uint8_t buffer[2];

  buffer[0] = 0x00;
  buffer[1] = command;
  i2c_write_blocking(display->i2c, display->address, buffer, 2, false);
}

void ssd1306_init(ssd1306_t *display, i2c_inst_t *i2c_instance, uint8_t address, uint8_t width, uint8_t height) {
  static const uint8_t init_commands[] = {
      SSD1306_DISPLAYOFF,
      SSD1306_SETDISPLAYCLOCKDIV, 0x80,
      SSD1306_SETMULTIPLEX, 0x1F,
      SSD1306_SETDISPLAYOFFSET, 0x00,
      SSD1306_SETSTARTLINE,
      SSD1306_CHARGEPUMP, 0x14,
      SSD1306_MEMORYMODE, 0x00,
      SSD1306_SEGREMAP | 0x01,
      SSD1306_COMSCANDEC,
      SSD1306_SETCOMPINS, 0x02,
      SSD1306_SETCONTRAST, 0x8F,
      SSD1306_SETPRECHARGE, 0xF1,
      SSD1306_SETVCOMDETECT, 0x40,
      SSD1306_DISPLAYALLON_RESUME,
      SSD1306_NORMALDISPLAY,
      SSD1306_DISPLAYON
  };
  size_t index;

  display->i2c = i2c_instance;
  display->address = address;
  display->width = width;
  display->height = height;
  display->pages = height / 8U;
  memset(display->buffer, 0, sizeof(display->buffer));

  for (index = 0; index < sizeof(init_commands); ++index) {
    ssd1306_command(display, init_commands[index]);
  }
}

void ssd1306_clear(ssd1306_t *display) {
  memset(display->buffer, 0, display->width * display->pages);
}

void ssd1306_show(ssd1306_t *display) {
  uint32_t index;

  ssd1306_command(display, SSD1306_COLUMNADDR);
  ssd1306_command(display, 0);
  ssd1306_command(display, display->width - 1U);
  ssd1306_command(display, SSD1306_PAGEADDR);
  ssd1306_command(display, 0);
  ssd1306_command(display, display->pages - 1U);

  for (index = 0; index < (uint32_t) display->width * display->pages; index += 16U) {
    uint8_t packet[17];
    uint32_t remaining;
    uint32_t chunk_size;

    remaining = (uint32_t) display->width * display->pages - index;
    chunk_size = remaining < 16U ? remaining : 16U;
    packet[0] = 0x40;
    memcpy(&packet[1], &display->buffer[index], chunk_size);
    i2c_write_blocking(display->i2c, display->address, packet, chunk_size + 1U, false);
  }
}

void ssd1306_set_pixel(ssd1306_t *display, uint8_t x, uint8_t y, bool on) {
  uint8_t page;
  uint8_t bit;
  uint16_t index;

  if (x >= display->width || y >= display->height) {
    return;
  }

  page = y / 8U;
  bit = y % 8U;
  index = (uint16_t) x + (uint16_t) page * display->width;

  if (on) {
    display->buffer[index] |= (uint8_t) (1U << bit);
  } else {
    display->buffer[index] &= (uint8_t) ~(1U << bit);
  }
}

void ssd1306_draw_char(ssd1306_t *display, uint8_t x, uint8_t y, uint8_t scale, char character) {
  uint8_t width_index;
  uint8_t height_index;
  uint8_t font_index;

  if ((unsigned char) character < 32U || (unsigned char) character > 127U) {
    return;
  }

  font_index = (uint8_t) character - 32U;
  for (width_index = 0; width_index < 5U; ++width_index) {
    uint8_t font_line;

    font_line = FONT_5X8[font_index * 5U + width_index];
    for (height_index = 0; height_index < 8U; ++height_index) {
      if ((font_line & (1U << height_index)) != 0U) {
        uint8_t scale_x;
        uint8_t scale_y;

        for (scale_x = 0; scale_x < scale; ++scale_x) {
          for (scale_y = 0; scale_y < scale; ++scale_y) {
            ssd1306_set_pixel(display,
                              (uint8_t) (x + width_index * scale + scale_x),
                              (uint8_t) (y + height_index * scale + scale_y),
                              true);
          }
        }
      }
    }
  }
}

void ssd1306_draw_string(ssd1306_t *display, uint8_t x, uint8_t y, uint8_t scale, const char *text) {
  uint8_t current_x;

  current_x = x;
  while (*text != '\0') {
    ssd1306_draw_char(display, current_x, y, scale, *text);
    current_x = (uint8_t) (current_x + 6U * scale);
    ++text;

    if (current_x > (uint8_t) (display->width - 6U * scale)) {
      current_x = 0;
      y = (uint8_t) (y + 8U * scale);
      if (y > (uint8_t) (display->height - 8U * scale)) {
        break;
      }
    }
  }
}
